## tests/kernel/semaphore/semaphore_new_api/sem_give_from_isr_or_thread/testcase.yaml
```yaml
tests:
  kernel.semaphore.give_from_isr_or_thread:
    min_ram: 32
    tags: kernel userspace
```

## tests/kernel/semaphore/semaphore_new_api/sem_init_at_comp_time/testcase.yaml
```yaml
tests:
  kernel.semaphore.init_at_comp_time:
    min_ram: 32
    tags: kernel userspace
```

## tests/kernel/semaphore/semaphore_new_api/sem_max_number_defined/testcase.yaml
```yaml
tests:
  kernel.semaphore.max_number_defined:
    min_ram: 32
    tags: kernel userspace
```

## tests/kernel/semaphore/semaphore_new_api/sem_take_by_high_prio_thread/testcase.yaml
```yaml
tests:
  kernel.semaphore.take_by_high_prio_thread:
    min_ram: 32
    tags: kernel userspace
```
